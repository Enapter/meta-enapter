## meta-enapter-core/conf/layer.conf
```bitbake
BBPATH =. "${LAYERDIR}:"

BBFILES += "${LAYERDIR}/recipes-*/*/*.bb \
            ${LAYERDIR}/recipes-*/*/*.bbappend"

BBFILE_COLLECTIONS += "enapter-core"
BBFILE_PATTERN_enapter-core = "^${LAYERDIR}/"
BBFILE_PRIORITY_enapter-core = "9"

LAYERDEPENDS_enapter-core = "core"
LAYERDEPENDS_enapter-core += "filesystems-layer"
LAYERDEPENDS_enapter-core += "intel"
LAYERDEPENDS_enapter-core += "meta-initramfs"
LAYERDEPENDS_enapter-core += "meta-python"
LAYERDEPENDS_enapter-core += "networking-layer"
LAYERDEPENDS_enapter-core += "openembedded-layer"
LAYERDEPENDS_enapter-core += "virtualization-layer"
LAYERDEPENDS_enapter-core += "webserver"
LAYERDEPENDS_enapter-core += "yoctobsp"

BBFILES_DYNAMIC += " \
    rauc:${LAYERDIR}/dynamic-layers/meta-rauc/recipes-*/*/*.bbappend \
"

LAYERSERIES_COMPAT_enapter-core = "scarthgap"

LAYERVERSION_enapter-core = "1"
```
